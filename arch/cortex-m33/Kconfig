## arch/cortex-m33/Kconfig
```kconfig
#
# For a description of the syntax of this configuration file,
# see the file kconfig-language.txt in the docs folder of mTower repository.
#

choice
	prompt "MCU Family"
	default ARCH_FAMILY_MPS2

config ARCH_FAMILY_MPS2
	bool "MPS2"
	---help---
		The MPS2 architecture

config ARCH_FAMILY_LPC
	bool "LPC"
	---help---
		The LPC architecture

endchoice

config ARCH_FAMILY
	string
	default "mps2"            if ARCH_FAMILY_MPS2
	default "lpc"            if ARCH_FAMILY_LPC

if ARCH_FAMILY_MPS2
comment "MPS2 Configuration Options"
source arch/cortex-m33/mps2/Kconfig
endif

if ARCH_FAMILY_LPC
comment "LPC Configuration Options"
source arch/cortex-m33/lpc/Kconfig
endif
```

## arch/cortex-m33/lpc/Kconfig
```kconfig
#
# For a description of the syntax of this configuration file,
# see the file kconfig-language.txt in the docs folder of mTower repository.
#

choice
	prompt "lpc55S69 platform selection"
	default PLATFORM_LPC55S69

config PLATFORM_LPC55S69
	bool "lpc55s69 board"
	---help---
		LPC55S69 board.

endchoice

config PLATFORM
	string
	default "lpc55s69"  if PLATFORM_LPC55S69

if PLATFORM_LPC55S69
#comment "lpc55s69 Peripheral Configuration Options"
source arch/cortex-m33/lpc/src/lpc55s69/Kconfig
endif # PLATFORM_LPC55S69
```
